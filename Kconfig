## src/Kconfig.serial
```kconfig
# Copyright (c) The ThingSet Project Contributors
# SPDX-License-Identifier: Apache-2.0

menuconfig THINGSET_SERIAL
	bool "Serial interface"

if THINGSET_SERIAL

config THINGSET_SERIAL_RX_BUF_SIZE
	int "ThingSet serial RX buffer size"
	range 64 2048
	default 512

config THINGSET_SERIAL_USE_CRC
	bool "Use CRC-32 incoming and outgoing messages"
	select CRC
	default y
	help
	  A CRC is appended to all outgoing messages. If incoming messages contain a CRC, it is
	  validated and messages are discarded if the CRC is invalid.

	  If incoming messages don't contain a CRC, they are still accepted in order to allow simple
	  communication with humans.

config THINGSET_SERIAL_ENFORCE_CRC
	bool "Enforce CRC-32 for all incoming messages"
	depends on THINGSET_SERIAL_USE_CRC
	help
	  If enabled, incoming messages without CRC are not accepted.

endif # THINGSET_SERIAL
```

## src/Kconfig.shell
```kconfig
# Copyright (c) The ThingSet Project Contributors
# SPDX-License-Identifier: Apache-2.0

menuconfig THINGSET_SHELL
	bool "Shell command"
	depends on SHELL
	help
	  Should not be used with the same serial interface as THINGSET_SERIAL

if THINGSET_SHELL

config THINGSET_SHELL_CMD_BUF_SIZE
	int "ThingSet shell command buffer size"
	range 64 2048
	default 128

config THINGSET_SHELL_REPORTING
	bool "Print regular reports to shell"
	default y
	help
	  Printing live metrics reports to the shell can quickly flood the shell
	  with too many messages.

	  Disable if reporting interval is too short and your shell is flooded.

endif # THINGSET_SHELL
```

## src/Kconfig.storage
```kconfig
# Copyright (c) The ThingSet Project Contributors
# SPDX-License-Identifier: Apache-2.0

menuconfig THINGSET_STORAGE
	bool "Storage backend"
	depends on EEPROM || NVS
	help
	  Enables long-term storage of data in non-volatile memory (EEPROM or Flash).

if THINGSET_STORAGE

choice THINGSET_STORAGE_TYPE
	prompt "Storage type"
	help
	   Select whether the data should be stored in EEPROM or Flash.

config THINGSET_STORAGE_EEPROM
	bool "EEPROM"
	depends on EEPROM
	select CRC

config THINGSET_STORAGE_FLASH
	bool "Flash/NVS"
	depends on NVS

endchoice

config THINGSET_STORAGE_LOAD_ATTEMPTS
	int "Maximum number of attempts to load data from storage at boot"
	range 1 100
	default 3
	help
	  Depending on the environment, loading data from e.g. an I2C EEPROM may fail occasionally
	  with bad CRCs due to noise in the communication. This Kconfig defines how often reading
	  from the storage should be retried.

config THINGSET_STORAGE_CHANGE
	bool "Store data upon change to ThingSet stored items"
	default y
	help
	  If enabled, a callback is invoked once a data object which is part of the TS_SUBSET_NVM is
	  changed.

config THINGSET_STORAGE_REGULAR
	bool "Store data in regular intervals"
	default y

config THINGSET_STORAGE_INTERVAL
	int "Regular storage interval (in hours)"
	depends on THINGSET_STORAGE_REGULAR
	range 1 8760
	default 6

config THINGSET_STORAGE_INHIBIT_OVERWRITE
	bool "Inhibit overwrite of data if reading failed"
	depends on THINGSET_STORAGE_REGULAR
	help
	  Disable regular storage in the background if previous loading of data failed because of
	  bad CRC or wrong data version. Only empty EEPROM data will be overwritten.

config THINGSET_STORAGE_DATA_VERSION
	int "Data objects version"
	range 1 65536
	default 1
	help
	  This version number has to be increased each time IDs previously used for data objects
	  stored in non-volatile memory are re-used for different data objects (different data type
	  or different semantics).

	  Warning: This will discard previously stored data in order to prevent data corruption. Try
	  to avoid changing data object IDs used previously.

config THINGSET_STORAGE_EEPROM_PROGRESSIVE_IMPORT_EXPORT
	bool "Enable progressive import/export for EEPROM storage."
	select THINGSET_PROGRESSIVE_IMPORT_EXPORT
	help
	  When enabled, allows the loading and saving of data larger than the shared buffer
	  in EEPROM.

config THINGSET_STORAGE_EEPROM_DUPLICATE
	bool "Write EEPROM data twice to recover from power failures"
	depends on THINGSET_STORAGE_EEPROM
	help
	  Divides the available EEPROM memory into two equal sections and writes the data into both
	  sections each time. This allows to recover from power failures because at least one
	  section will always have valid data.

config THINGSET_STORAGE_EEPROM_CHUNK_SIZE
	int "Size of chunk when reading from/writing to EEPROM"
	default 128
	depends on THINGSET_STORAGE_EEPROM
	help
	  When reading from or writing to EEPROM, transfer the data in chunks of this size.
	  This may resolve issues related to limitations with the I2C bus.

endif # THINGSET_STORAGE
```

## src/Kconfig.websocket
```kconfig
# Copyright (c) The ThingSet Project Contributors
# SPDX-License-Identifier: Apache-2.0

config THINGSET_WEBSOCKET
	depends on WEBSOCKET_CLIENT
	bool "WebSocket interface"

if THINGSET_WEBSOCKET

config THINGSET_WEBSOCKET_SERVER_HOST
	string "Default WebSocket server host name"
	help
	  This default host name can be changed via ThingSet.

config THINGSET_WEBSOCKET_SERVER_PORT
	int "Default WebSocket server port"
	default 80
	help
	  This default port can be changed via ThingSet.

config THINGSET_WEBSOCKET_AUTH_TOKEN
	string "Default WebSocket server port"
	help
	  This default port can be changed via ThingSet.

config THINGSET_WEBSOCKET_RX_BUF_SIZE
	int "ThingSet WebSocket RX buffer size"
	range 512 4096
	default 1024

config THINGSET_WEBSOCKET_THREAD_STACK_SIZE
	int "ThingSet WebSocket thread stack size"
	default 4096
	help
	  Stack size of thread for processing ThingSet messages transmitted
	  via WebSocket.

config THINGSET_WEBSOCKET_THREAD_PRIORITY
	int "ThingSet WebSocket thread priority"
	default 2
	help
	  Priority of thread for processing ThingSet messages transmitted
	  via WebSocket.

endif # THINGSET_WEBSOCKET
```

## src/Kconfig.wifi
```kconfig
# Copyright (c) The ThingSet Project Contributors
# SPDX-License-Identifier: Apache-2.0

config THINGSET_WIFI
    depends on WIFI
    bool "WiFi interface"
```

## tests/can/testcase.yaml
```yaml
# SPDX-License-Identifier: Apache-2.0

tests:
  thingset_sdk.can:
    integration_platforms:
      - native_sim_64
    extra_args: EXTRA_CFLAGS=-Werror
  thingset_sdk.can.isotp_fast:
    integration_platforms:
      - native_sim_64
    extra_args: EXTRA_CFLAGS=-Werror
    extra_configs:
      - CONFIG_ISOTP_FAST=y
      - CONFIG_ISOTP_USE_TX_BUF=y
```

## tests/isotp_fast/conformance/testcase.yaml
```yaml
tests:
  thingset_sdk.isotp_fast.conformance.sync:
    tags:
      - can
      - isotp
    depends_on: can
    integration_platforms:
      - native_posix_64
    filter: dt_chosen_enabled("zephyr,canbus") and not dt_compat_enabled("kvaser,pcican")
    extra_args: EXTRA_CFLAGS=-Werror
    extra_configs:
      - CONFIG_ISOTP_FAST_BLOCKING_RECEIVE=y
  thingset_sdk.isotp_fast.conformance.async:
    tags:
      - can
      - isotp
    depends_on: can
    integration_platforms:
      - native_posix_64
    filter: dt_chosen_enabled("zephyr,canbus") and not dt_compat_enabled("kvaser,pcican")
    extra_configs:
      - CONFIG_ISOTP_FAST_PER_FRAME_DISPATCH=y
  thingset_sdk.isotp_fast.conformance.async.fd:
    tags:
      - can
      - isotp
    depends_on: can
    integration_platforms:
      - native_posix_64
    filter: dt_chosen_enabled("zephyr,canbus") and not dt_compat_enabled("kvaser,pcican")
    extra_args: EXTRA_CFLAGS=-Werror
    extra_configs:
      - CONFIG_ISOTP_FAST_PER_FRAME_DISPATCH=y
      - CONFIG_CAN_FD_MODE=y
```

## tests/isotp_fast/conformance_async_fd/testcase.yaml
```yaml
tests:
  thingset_sdk.isotp_fast.conformance.async.fd:
    tags:
      - can
      - isotp
    depends_on: can
    integration_platforms:
      - native_posix_64
    filter: dt_chosen_enabled("zephyr,canbus") and not dt_compat_enabled("kvaser,pcican")
```

## tests/storage_eeprom/testcase.yaml
```yaml
# SPDX-License-Identifier: Apache-2.0

tests:
  thingset_sdk.storage_eeprom.default:
    integration_platforms:
      - native_posix_64
    platform_exclude:
      # native sim with at24 emul EEPROM currently fails for unknown reasons
      - native_sim
    extra_args: EXTRA_CFLAGS=-Werror
  thingset_sdk.storage_eeprom.inhibit_overwrite:
    integration_platforms:
      - native_posix_64
    extra_args: EXTRA_CFLAGS=-Werror
    extra_configs:
      - CONFIG_THINGSET_STORAGE_INHIBIT_OVERWRITE=y
  thingset_sdk.storage_eeprom.duplicate:
    integration_platforms:
      - native_posix_64
    platform_exclude:
      # native sim with at24 emul EEPROM currently fails for unknown reasons
      - native_sim
    extra_args: EXTRA_CFLAGS=-Werror
    extra_configs:
      - CONFIG_THINGSET_STORAGE_EEPROM_DUPLICATE=y
  thingset_sdk.storage_eeprom.progressive:
    integration_platforms:
      - native_posix_64
    platform_exclude:
      # native sim with at24 emul EEPROM currently fails for unknown reasons
      - native_sim
    extra_args: EXTRA_CFLAGS=-Werror
    extra_configs:
      - CONFIG_THINGSET_STORAGE_EEPROM_PROGRESSIVE_IMPORT_EXPORT=y
  thingset_sdk.storage_eeprom.progressive_duplicate:
    integration_platforms:
      - native_posix_64
    platform_exclude:
      # native sim with at24 emul EEPROM currently fails for unknown reasons
      - native_sim
    extra_args: EXTRA_CFLAGS=-Werror
    extra_configs:
      - CONFIG_THINGSET_STORAGE_EEPROM_PROGRESSIVE_IMPORT_EXPORT=y
      - CONFIG_THINGSET_STORAGE_EEPROM_DUPLICATE=y
```

## tests/thingset_isotp_fast/testcase.yaml
```yaml
# SPDX-License-Identifier: Apache-2.0

tests:
  thingset_sdk.thingset_isotp_fast:
    integration_platforms:
      - native_posix_64
    extra_args: EXTRA_CFLAGS=-Wno-error
```

## west.yml
```yaml
# Copyright (c) The ThingSet Project Contributors
# SPDX-License-Identifier: Apache-2.0

manifest:
  remotes:
    - name: zephyrproject
      url-base: https://github.com/zephyrproject-rtos
    - name: thingset
      url-base: https://github.com/ThingSet
    - name: libresolar
      url-base: https://github.com/LibreSolar
  projects:
    - name: zephyr
      remote: zephyrproject
      revision: v4.0-branch
      import:
        name-allowlist:
          - cmsis
          - edtt
          - hal_espressif
          - hal_nordic
          - hal_stm32
          - hal_st
          - loramac-node
          - mbedtls
          - mcuboot
          - picolibc
          - segger
          - tinycrypt
          - zcbor
    - name: thingset-node-c
      remote: thingset
      revision: 3883e8fd429a7b8a2916c730c42aa1aabe48dfb3
      path: modules/thingset-node-c
      import: true
```
