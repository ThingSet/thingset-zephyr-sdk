## Kconfig
```kconfig
# Copyright (c) The ThingSet Project Contributors
# SPDX-License-Identifier: Apache-2.0

menuconfig THINGSET_SDK
    bool "ThingSet SDK"

if THINGSET_SDK

rsource "src/Kconfig.auth"
rsource "src/Kconfig.ble"
rsource "src/Kconfig.can"
rsource "src/Kconfig.log_backend"
rsource "src/Kconfig.lorawan"
rsource "src/Kconfig.serial"
rsource "src/Kconfig.shell"
rsource "src/Kconfig.storage"
rsource "src/Kconfig.websocket"
rsource "src/Kconfig.wifi"

menu "General Publication Settings"

config THINGSET_SUBSET_LIVE_METRICS
    bool "Use mLive subset (for regular reporting)"
    default y
    help
      The live metrics subset is meant for data that is published very frequently
      with intervals in the range of a few seconds.

config THINGSET_REPORTING_LIVE_ENABLE_PRESET
    bool "Enable regular reporting of live metrics by default"
    depends on THINGSET_SUBSET_LIVE_METRICS
    default y

config THINGSET_REPORTING_LIVE_PERIOD_PRESET
    int "Default period (s) for live metrics reporting"
    depends on THINGSET_SUBSET_LIVE_METRICS
    default 1

config THINGSET_SUBSET_SUMMARY_METRICS
    bool "Use mSummary subset (for infrequent reporting)"
    default y if THINGSET_LORAWAN
    help
      The summary metrics subset is meant for data that should be published
      seldomly, e.g. LoRaWAN messages.

config THINGSET_REPORTING_SUMMARY_ENABLE_PRESET
    bool "Enable regular reporting of summary metrics by default"
    depends on THINGSET_SUBSET_SUMMARY_METRICS
    default y

config THINGSET_REPORTING_SUMMARY_PERIOD_PRESET
    int "Default period (s) for summary metrics reporting"
    depends on THINGSET_SUBSET_SUMMARY_METRICS
    default 900

endmenu # General Publication Settings

config THINGSET_GENERATE_NODE_ID
    bool "Automatically generate node ID"
    select HWINFO
    default y

config THINGSET_NODE_NAME
    string "Default ThingSet node name"
    default "ThingSet Node"
    help
      This node name is used for the pNodeName item and should be a description of
      the device understandable by humans, e.g. the device type.

config THINGSET_SHARED_TX_BUF_SIZE
    int "Shared TX buffer size"
    range 256 10240
    default 1024
    help
      This buffer is used to create ThingSet responses for the different interfaces. It has to be
      large enough to fit the largest expected response.

config THINGSET_SDK_THREAD_STACK_SIZE
	int "Common thread stack size"
	default 2048
	help
	  Stack size of thread running ThingSet background services.

config THINGSET_SDK_THREAD_PRIORITY
	int "Common thread priority"
	default 2
	help
	  Priority of the thread running ThingSet background services.

module = THINGSET_SDK
module-str = thingset_sdk
source "subsys/logging/Kconfig.template.log_config"

endif # THINGSET_SDK
```

## samples/counter/boards/esp32c3_devkitm.conf
```kconfig
# Copyright (c) The ThingSet Project Contributors
# SPDX-License-Identifier: Apache-2.0

CONFIG_BT=y
CONFIG_BT_PERIPHERAL=y
CONFIG_BT_DEVICE_NAME="ThingSetNode"
CONFIG_BT_DEVICE_NAME_DYNAMIC=y
CONFIG_BT_GATT_CLIENT=y

# Increase buffer sizes to allow long ATT values
CONFIG_BT_BUF_ACL_RX_SIZE=251
CONFIG_BT_BUF_ACL_TX_SIZE=251
CONFIG_BT_L2CAP_TX_MTU=251

CONFIG_THINGSET_BLE=y

CONFIG_MPU_ALLOW_FLASH_WRITE=y
CONFIG_FLASH=y
CONFIG_FLASH_PAGE_LAYOUT=y
CONFIG_NVS=y

CONFIG_THINGSET_STORAGE=y
```

## samples/counter/boards/native_posix.conf
```kconfig
# Copyright (c) The ThingSet Project Contributors
# SPDX-License-Identifier: Apache-2.0

# required to generate device ID
CONFIG_ENTROPY_GENERATOR=y
CONFIG_ENTROPY_DEVICE_RANDOM_GENERATOR=y
```

## samples/counter/boards/xiao_esp32c3.conf
```kconfig
# Copyright (c) The ThingSet Project Contributors
# SPDX-License-Identifier: Apache-2.0

CONFIG_MPU_ALLOW_FLASH_WRITE=y
CONFIG_FLASH=y
CONFIG_FLASH_PAGE_LAYOUT=y
CONFIG_NVS=y

CONFIG_THINGSET_STORAGE=y
```

## samples/serial/Kconfig
```kconfig
# Copyright (c) 2022 Martin Jäger

mainmenu "ThingSet sample for serial interface"

rsource "../../Kconfig"

# include main Zephyr menu entries from Zephyr root directory
source "Kconfig.zephyr"
```

## src/Kconfig.auth
```kconfig
# Copyright (c) The ThingSet Project Contributors
# SPDX-License-Identifier: Apache-2.0

menuconfig THINGSET_AUTH
    bool "Basic Authentication"

if THINGSET_AUTH

config THINGSET_AUTH_TOKEN_MAX_SIZE
    int "Auth token max size"
    range 8 65
    default 16

config THINGSET_AUTH_TOKEN_EXPERT
    string "Token to authenticate as expert user"

config THINGSET_AUTH_TOKEN_MANUFACTURER
    string "Token to authenticate as manufacturer"

endif # THINGSET_AUTH
```

## src/Kconfig.ble
```kconfig
# Copyright (c) The ThingSet Project Contributors
# SPDX-License-Identifier: Apache-2.0

menuconfig THINGSET_BLE
	bool "Bluetooth LE interface"
	depends on BT

if THINGSET_BLE

config THINGSET_BLE_RX_BUF_SIZE
	int "ThingSet BLE RX buffer size"
	range 64 2048
	default 512

endif # THINGSET_BLE
```

## src/Kconfig.bluetooth
```kconfig
# Copyright (c) The ThingSet Project Contributors
# SPDX-License-Identifier: Apache-2.0

config THINGSET_BLE
	bool "Bluetooth LE [DEPRECATED]"
	select THINGSET_BLUETOOTH
	select DEPRECATED
	help
	  This option is deprecated and should be replaced with THINGSET_BLUETOOTH.

menuconfig THINGSET_BLUETOOTH
	bool "Bluetooth Low Energy interface"
	depends on BT

if THINGSET_BLUETOOTH

config THINGSET_BLUETOOTH_RX_BUF_SIZE
	int "ThingSet Bluetooth RX buffer size"
	range 64 2048
	default 512

endif # THINGSET_BLUETOOTH
```

## src/Kconfig.can
```kconfig
# Copyright (c) The ThingSet Project Contributors
# SPDX-License-Identifier: Apache-2.0

menuconfig THINGSET_CAN
    bool "CAN interface"
    depends on CAN
    depends on ISOTP_FAST
    depends on ENTROPY_GENERATOR
    select EVENTS
    select ISOTP_FAST_CUSTOM_ADDRESSING

if THINGSET_CAN

config THINGSET_CAN_RX_BUF_SIZE
    int "ThingSet CAN RX buffer size"
    range 64 2048
    default 600
    help
      Default value large enough to receive a 512 byte flash page for DFU.

config THINGSET_CAN_ITEM_RX
    bool "Support for reception of single-frame data items"
    help
      Single-frame reports containing one data item (type 0x2) are usually used
      for control purposes. Enable this option to allow configuring a receive
      callback once single-frame reports from other nodes were received.

      For normal reports, the multi-frame reports of type 0x1 are more
      efficient (especially in case of CAN FD).

config THINGSET_CAN_REPORT_RX
    bool "Support for reception of multi-frame reports"
    help
      Multi-frame reports (type 0x1) are used to publish data items of one
      group, subset or record over CAN. The size of one frame is 8 bytes
      for classical CAN or up to 64 for CAN FD.

config THINGSET_CAN_REPORT_RX_BUFFER_SIZE
    int "ThingSet CAN RX buffer size for reassembly of packetized reports"
    depends on THINGSET_CAN_REPORT_RX
    range 32 1024
    default 64
    help
      Default value enough to receive at least a 10-element array via broadcast.

config THINGSET_CAN_REPORT_RX_NUM_BUFFERS
    int "ThingSet CAN number of RX buffers for reassembly of packetized reports"
    depends on THINGSET_CAN_REPORT_RX
    range 1 64
    default 8
    help
      Maximum number of unique senders anticipated on the CAN bus.

config THINGSET_CAN_REPORT_RX_BUCKETS
    int "ThingSet CAN number of buckets into which RX buffers are divided"
    depends on THINGSET_CAN_REPORT_RX
    range 1 16
    default 8
    help
      This is the number of entries in the hashtable used to efficiently look
      up current buffers. The hash function is simply a modulo operation, so
      for maximum efficiency a power-of-2 value should be used.

config THINGSET_CAN_REPORT_SEND_TIMEOUT
    int "ThingSet CAN report send timeout"
    range 0 100
    default 30
    help
      Timeout in milliseconds to wait for a report frame to be successfully
      submitted to the CAN TX FIFO.

config THINGSET_CAN_FRAME_SEPARATION_TIME
    int "ThingSet CAN minimum frame separation time"
    range 0 127
    default 1
    help
      Minimum time in milliseconds between the end of one frame and the
      beginning of the next consecutive frame in multi-frame messages.

      This parameter is used for the STmin value in the underlying ISO-TP
      protocol of request/response messages and as a delay between individual
      frames of multi-frame reports.

config THINGSET_CAN_CONTROL_REPORTING
    bool "Publish data of control subset"
    help
      Enable automatic publication of control data. The subset is application-
      specific and has to be specified.

config THINGSET_CAN_CONTROL_SUBSET
    bool "Subset containing control data to be published"
    depends on THINGSET_CAN_CONTROL_REPORTING

config THINGSET_CAN_CONTROL_REPORTING_PERIOD
    bool "Control data reporting interval in milliseconds"
    depends on THINGSET_CAN_CONTROL_REPORTING
    default 100

choice THINGSET_CAN_ROUTING
    prompt "Message routing scheme"
    default THINGSET_CAN_ROUTING_BUSES
    help
      Select how frames should be routed between different buses.

config THINGSET_CAN_ROUTING_BUSES
    bool "Bus numbers"
    depends on ISOTP_FAST
    select ISOTP_FAST_CUSTOM_ADDRESSING
    help
      Bits 16-23 of the CAN ID are used for a target bus (higher nibble) and a
      source bus (lower nibble).

      Buses should be used to allow message routing from one bus to any other bus.
      There is no hierarchy between the buses.

config THINGSET_CAN_ROUTING_BRIDGES
    bool "Bridge numbers"
    select ISOTP_FAST_FIXED_ADDRESSING
    help
      Bits 16-23 of the CAN ID are used to define a bridge number between 1 and
      255. Each bridge defines the connection between two fixed buses. Bridge
      number 0 is reserved local communication on the same bus (i.e. no routing).

      Bridges should be used if the maximum amount of 16 buses is not
      sufficient. Otherwise, routing using bus numbers are more simple and generic.

endchoice

config THINGSET_CAN_MULTIPLE_INSTANCES
    bool "Support for multiple ThingSet CAN instances"
    depends on ISOTP_FAST
    help
      If enabled, the CAN message processing does not happen in the
      background anymore. Instead, each instance has to be initialized
      for a dedicated CAN device and and messages have to be processed
      manually in application threads.

      The bus numbering scheme in the CAN ID is not compatible with
      the current Zephyr upstream ISO-TP implementation, so it depends
      on ISOTP_FAST.

config THINGSET_CAN_DEFAULT_ROUTE
    int "ThingSet CAN default route"
    depends on !THINGSET_CAN_MULTIPLE_INSTANCES
    range 0 15 if THINGSET_CAN_ROUTING_BUSES
    range 0 255 if THINGSET_CAN_ROUTING_BRIDGES
    default 0
    help
      The bus or bridge number (depending on THINGSET_CAN_ROUTING choice) is
      used to route messages between different buses.

      For a single bus system, the default 0 should be used.

config THINGSET_CAN_RESPONSE_DELAY
    int "ThingSet CAN response delay"
    range 0 100
    default 10
    help
      Wait for the specified delay in milliseconds before sending out a
      response after a request was received.

      This delay gives the requesting side some more time to switch between
      sending and receiving mode, as the Zephyr ISO-TP implementation does
      not allow to use the same ID for listening and sending simultaneously.

config THINGSET_CAN_THREAD_STACK_SIZE
    int "ThingSet CAN thread stack size"
    depends on !THINGSET_CAN_MULTIPLE_INSTANCES
    default 2048
    help
      Stack size of thread for processing ThingSet messages transmitted
      via CAN ISO-TP.

      Only available for single-instance implementation.

config THINGSET_CAN_THREAD_PRIORITY
    int "ThingSet CAN thread priority"
    depends on !THINGSET_CAN_MULTIPLE_INSTANCES
    default 2
    help
      Priority of thread for processing ThingSet messages transmitted
      via CAN ISO-TP.

      Only available for single-instance implementation.

endif # THINGSET_CAN
```

## src/Kconfig.dfu
```kconfig
# Copyright (c) The ThingSet Project Contributors
# SPDX-License-Identifier: Apache-2.0

menuconfig THINGSET_DFU
    bool "ThingSet device firmware upgrade"
    depends on FLASH
    depends on FLASH_MAP
    depends on FLASH_PAGE_LAYOUT
    depends on IMG_MANAGER
    select THINGSET_BYTES_TYPE_SUPPORT
    select REBOOT

if THINGSET_DFU

config THINGSET_DFU_CHUNK_SIZE
    int "Firmware chunk size"
    range 64 4096
    default 256
    help
      Maximum chunk size that can be transmitted in one ThingSet message.

endif # THINGSET_DFU
```

## src/Kconfig.isotp_fast
```kconfig
menuconfig ISOTP_FAST
    bool "New ISO-TP context"
    depends on CAN
    depends on ISOTP
    select EVENTS

if ISOTP_FAST

config ISOTP_FAST_NORMAL_ADDRESSING
  bool "Enable normal addressing"
  default true
  help
    Whether to enable normal (11- or 29-bit) addressing.

config ISOTP_FAST_FIXED_ADDRESSING
  bool "Enable fixed addressing"
  default false
  help
    Whether to enable SAE J1939-style fixed addressing.

config ISOTP_FAST_EXTENDED_ADDRESSING
  bool "Enable extended addressing"
  default false
  help
    Whether to enable extended addressing (address in first byte of payload).

config ISOTP_FAST_CUSTOM_ADDRESSING
  bool "Custom addressing"
  default false
  help
    Whether to enable the custom callback to determine a reply
    address for a given inbound message.

if ISOTP_FAST_CUSTOM_ADDRESSING

config ISOTP_FAST_CUSTOM_ADDRESSING_RX_MASK
  hex "RX mask for custom addressing mode"
  default 0x0300ff00
  help
    Mask to match incoming messages in custom addressing mode.

endif # ISOTP_FAST_CUSTOM_ADDRESSING

config ISOTP_FAST_RX_MAX_PACKET_COUNT
  int "Max packets for ISO-TP reception"
  default 8
  help
    Max number of packets expected in a single ISO-TP message.

config ISOTP_FAST_RX_BUF_COUNT
  int "Max number of RX buffers"
  default 4
  help
    This broadly implies the max number of simultaneous receptions.

config ISOTP_FAST_TX_BUF_COUNT
  int "Max number of TX buffers"
  default 4
  help
    This broadly implies the max number of simultaneous transmissions.

config ISOTP_FAST_PER_FRAME_DISPATCH
  bool "Per-frame dispatch"
  default false
  help
    Whether to invoke the receive callback on receipt of every frame

config ISOTP_FAST_BLOCKING_RECEIVE
  bool "Blocking receive"
  default false
  depends on !ISOTP_FAST_PER_FRAME_DISPATCH
  help
    Whether to make blocking receive functionality available
    to ease migration from the old API.

endif
```

## src/Kconfig.log_backend
```kconfig
# Copyright (c) The ThingSet Project Contributors
# SPDX-License-Identifier: Apache-2.0

menuconfig THINGSET_LOG_BACKEND
	bool "Logging backend"
	depends on LOG
	depends on LOG_MODE_DEFERRED
	select LOG_OUTPUT
	select THINGSET_JSON_STRING_ESCAPING

if THINGSET_LOG_BACKEND

config THINGSET_LOG_BACKEND_BUF_SIZE
	int "Logging backend buffer size"
	range 32 512
	default 64
	help
	  Maximum message size that can be transmitted over the ThingSet log message item.
	  Two buffers of this size have to be allocated in RAM.

config THINGSET_LOG_BACKEND_USE_UPTIME
	bool "Use logger timestamp as absolute UNIX timestamp"
	help
	  ThingSet timestamp items "t_s" must use absolute UNIX timestamps. However, the logger
	  timestamp is the uptime of the MCU.

	  Enable this option only for testing, as processed ThingSet data might end up in a database
	  with a wrong timestamp.

endif # THINGSET_LOG_BACKEND
```

## src/Kconfig.lorawan
```kconfig
# Copyright (c) The ThingSet Project Contributors
# SPDX-License-Identifier: Apache-2.0

config THINGSET_LORAWAN
	depends on LORAWAN
	bool "LoRaWAN interface"

if THINGSET_LORAWAN

config THINGSET_LORAWAN_ABP
	bool "Support for ABP activation"
	help
	  Enable End-Device activation for Activation By Personalization(ABP).

endif # THINGSET_LORAWAN
```
