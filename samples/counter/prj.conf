## CMakeLists.txt
```
# Copyright (c) The ThingSet Project Contributors
# SPDX-License-Identifier: Apache-2.0

cmake_minimum_required(VERSION 3.13.1)
find_package(Zephyr REQUIRED HINTS $ENV{ZEPHYR_BASE})

project(thingset_sample_counter)

target_include_directories(app PRIVATE src)

target_sources(app PRIVATE src/main.c)
```

## prj.conf
```kconfig
# Copyright (c) The ThingSet Project Contributors
# SPDX-License-Identifier: Apache-2.0

CONFIG_LOG=y
CONFIG_LOG_MODE_MINIMAL=y

# ThingSet library
CONFIG_THINGSET=y
CONFIG_THINGSET_LOG_LEVEL_DBG=y

# ThingSet SDK
CONFIG_THINGSET_SDK=y
CONFIG_THINGSET_REPORTING_LIVE_PERIOD_PRESET_MS=10000

CONFIG_SHELL=y
# Avoid conflicts with ThingSet ? command
CONFIG_SHELL_WILDCARD=n
# Support `select thingset` to run ThingSet requests directly
CONFIG_SHELL_CMDS_SELECT=y

CONFIG_THINGSET_SHELL=y
CONFIG_THINGSET_SHELL_REPORTING=n
```

## auth.conf
```kconfig
# Copyright (c) The ThingSet Project Contributors
# SPDX-License-Identifier: Apache-2.0

CONFIG_THINGSET_AUTH=y
CONFIG_THINGSET_AUTH_TOKEN_EXPERT="expert"
CONFIG_THINGSET_AUTH_TOKEN_MANUFACTURER="manufacturer"
```

## ble.conf
```kconfig
# Copyright (c) The ThingSet Project Contributors
# SPDX-License-Identifier: Apache-2.0

CONFIG_BT=y
CONFIG_BT_PERIPHERAL=y
CONFIG_BT_DEVICE_NAME="ThingSetNode"
CONFIG_BT_DEVICE_NAME_DYNAMIC=y
CONFIG_BT_GATT_CLIENT=y

# Increase buffer sizes to allow long ATT values
CONFIG_BT_BUF_ACL_RX_SIZE=251
CONFIG_BT_BUF_ACL_TX_SIZE=251
CONFIG_BT_L2CAP_TX_MTU=251

CONFIG_THINGSET_BLE=y
```

## bluetooth.conf
```kconfig
# Copyright (c) The ThingSet Project Contributors
# SPDX-License-Identifier: Apache-2.0

CONFIG_BT=y
CONFIG_BT_PERIPHERAL=y
CONFIG_BT_DEVICE_NAME="ThingSetNode"
CONFIG_BT_DEVICE_NAME_DYNAMIC=y
CONFIG_BT_GATT_CLIENT=y

# Increase buffer sizes to allow long ATT values
CONFIG_BT_BUF_ACL_RX_SIZE=251
CONFIG_BT_BUF_ACL_TX_SIZE=251
CONFIG_BT_L2CAP_TX_MTU=251

CONFIG_THINGSET_BLUETOOTH=y
```

## can.conf
```kconfig
# Copyright (c) The ThingSet Project Contributors
# SPDX-License-Identifier: Apache-2.0

# RNG required for automatic node address assignment
CONFIG_ENTROPY_GENERATOR=y
CONFIG_ENTROPY_DEVICE_RANDOM_GENERATOR=y

# CAN driver and ISO-TP subsystem
CONFIG_CAN=y
CONFIG_ISOTP=y
CONFIG_ISOTP_FAST=y

# ThingSet SDK
CONFIG_THINGSET_CAN=y
```

## dfu.conf
```kconfig
# Copyright (c) The ThingSet Project Contributors
# SPDX-License-Identifier: Apache-2.0

CONFIG_THINGSET_DFU=y

# Flash driver to store firmware image
CONFIG_FLASH=y
CONFIG_FLASH_MAP=y
CONFIG_FLASH_PAGE_LAYOUT=y
CONFIG_STREAM_FLASH=y
CONFIG_IMG_MANAGER=y

# Application-side MCUboot configuration
CONFIG_BOOTLOADER_MCUBOOT=y
CONFIG_MCUBOOT_SIGNATURE_KEY_FILE="bootloader/mcuboot/root-ec-p256.pem"
CONFIG_MCUBOOT_GENERATE_CONFIRMED_IMAGE=y
```

## log_backend.conf
```kconfig
# Copyright (c) The ThingSet Project Contributors
# SPDX-License-Identifier: Apache-2.0

# Enable ThingSet logging backend
CONFIG_THINGSET_LOG_BACKEND=y

# The log backend depends on deferred logging (otherwise logs are forwarded character-wise)
CONFIG_LOG_MODE_DEFERRED=y

# UART backend is not needed anymore, as ThingSet backend will also send report to serial
CONFIG_LOG_BACKEND_UART=n
```

## boards/esp32c3_devkitm.overlay
```dts
&wifi {
	status = "okay";
};
```

## boards/native_sim.overlay
```dts
/*
 * Copyright (c) The ThingSet Project Contributors
 *
 * SPDX-License-Identifier: Apache-2.0
 */

/ {
	chosen {
		zephyr,canbus = &can0;
	};
};

/*
 * Set up a virtual CAN interface with following commands:
 *
 * sudo ip link add dev vcan0 type vcan
 * sudo ip link set up vcan0
 */
&can0 {
	status = "okay";
	host-interface = "vcan0";
};
```

## src/main.c
```c
/*
 * Copyright (c) The ThingSet Project Contributors
 *
 * SPDX-License-Identifier: Apache-2.0
 */

#include <zephyr/kernel.h>

#include "thingset/sdk.h"

static uint32_t counter;
static float pi = 3.14F;

#define APP_ID_SAMPLE          0x05
#define APP_ID_SAMPLE_RCOUNTER 0x050
#define APP_ID_SAMPLE_WCOUNTER 0x051
#define APP_ID_SAMPLE_CPI      0x052

THINGSET_ADD_GROUP(TS_ID_ROOT, APP_ID_SAMPLE, "Sample", THINGSET_NO_CALLBACK);

THINGSET_ADD_ITEM_UINT32(APP_ID_SAMPLE, APP_ID_SAMPLE_RCOUNTER, "rCounter", &counter,
                         THINGSET_ANY_R, TS_SUBSET_LIVE | TS_SUBSET_SUMMARY);

THINGSET_ADD_ITEM_UINT32(APP_ID_SAMPLE, APP_ID_SAMPLE_WCOUNTER, "wCounter", &counter,
                         THINGSET_ANY_RW, TS_SUBSET_LIVE | TS_SUBSET_SUMMARY);

THINGSET_ADD_ITEM_FLOAT(APP_ID_SAMPLE, APP_ID_SAMPLE_CPI, "cPi", &pi, 2, THINGSET_ANY_R,
                        TS_SUBSET_LIVE | TS_SUBSET_SUMMARY);

int main(void)
{
    while (true) {
        counter++;
        k_sleep(K_SECONDS(1));
    }

    return 0;
}
```

## src/can.c
```c
/*
 * Copyright (c) The ThingSet Project Contributors
 *
 * SPDX-License-Identifier: Apache-2.0
 */

#include <zephyr/device.h>
#include <zephyr/kernel.h>

#include "thingset/can.h"
#include "thingset/sdk.h"

static const struct device *can_dev = DEVICE_DT_GET(DT_CHOSEN(zephyr_canbus));

static struct thingset_can ts_can;

static void thingset_can_thread()
{
    thingset_can_init(&ts_can, can_dev);

    while (true) {
        thingset_can_process(&ts_can, K_FOREVER);
    }
}

K_THREAD_DEFINE(thingset_can, CONFIG_THINGSET_CAN_THREAD_STACK_SIZE, thingset_can_thread, NULL,
                NULL, NULL, CONFIG_THINGSET_CAN_THREAD_PRIORITY, 0, 1000);
```
