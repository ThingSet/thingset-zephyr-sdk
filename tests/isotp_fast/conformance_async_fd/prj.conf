## CMakeLists.txt
```
# SPDX-License-Identifier: Apache-2.0

cmake_minimum_required(VERSION 3.20.0)
find_package(Zephyr REQUIRED HINTS $ENV{ZEPHYR_BASE})
project(isotp_fast_conformance_async_fd_test)

FILE(GLOB app_sources src/*.c)
target_sources(app PRIVATE ${app_sources})
```

## prj.conf
```kconfig
CONFIG_CAN=y
CONFIG_CAN_FD_MODE=y
CONFIG_ZTEST=y
CONFIG_ZTEST_NEW_API=y
CONFIG_ISOTP=y
CONFIG_ISOTP_FAST=y
CONFIG_ISOTP_USE_TX_BUF=y
CONFIG_ISOTP_RX_BUF_COUNT=8
CONFIG_ISOTP_FAST_RX_MAX_PACKET_COUNT=5
CONFIG_ISOTP_FAST_PER_FRAME_DISPATCH=y
```

## src/main.c
```c
/*
 * Copyright (c) 2023 Brill Power
 *
 * SPDX-License-Identifier: Apache-2.0
 */

#define ISOTP_FAST_CONFORMANCE_TEST_SUITE isotp_fast_conformance_async_fd
#include "../../conformance_async/src/async_recv.h"

#include "../../conformance/src/main.c"

ZTEST(ISOTP_FAST_CONFORMANCE_TEST_SUITE, test_sf_length)
{
    int ret;
    struct frame_desired des_frame;

    des_frame.data[0] = (SF_PCI_TYPE << PCI_TYPE_POS) | 7;
    memcpy(&des_frame.data[1], random_data, 7);
    des_frame.length = 8;

    /* mask to allow any priority and source address (SA) */
    filter_id = add_rx_msgq(tx_addr, CAN_EXT_ID_MASK);
    zassert_true((filter_id >= 0), "Negative filter number [%d]", filter_id);

    ret = isotp_fast_send(&ctx, random_data, 7, rx_node_id, INT_TO_POINTER(ISOTP_N_OK));
    zassert_equal(ret, 0, "Send returned %d", ret);

    check_frame_series(&des_frame, 1, &frame_msgq);

    des_frame.data[0] = (SF_PCI_TYPE << PCI_TYPE_POS);
    des_frame.data[1] = 9;
    memcpy(&des_frame.data[2], random_data, DATA_SIZE_SF);
    des_frame.length = 9;

    ret = isotp_fast_send(&ctx, random_data, 9, rx_node_id, INT_TO_POINTER(ISOTP_N_OK));
    zassert_equal(ret, 0, "Send returned %d", ret);

    check_frame_series(&des_frame, 1, &frame_msgq);
}
```
