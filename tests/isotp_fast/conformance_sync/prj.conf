## CMakeLists.txt
```
# SPDX-License-Identifier: Apache-2.0

cmake_minimum_required(VERSION 3.20.0)
find_package(Zephyr REQUIRED HINTS $ENV{ZEPHYR_BASE})
project(isotp_fast_conformance_sync_test)

FILE(GLOB app_sources src/*.c)
target_sources(app PRIVATE ${app_sources})
```

## prj.conf
```kconfig
CONFIG_CAN=y
CONFIG_ZTEST=y
CONFIG_ZTEST_NEW_API=y
CONFIG_ISOTP=y
CONFIG_ISOTP_FAST=y
CONFIG_ISOTP_USE_TX_BUF=y
CONFIG_ISOTP_RX_BUF_COUNT=8
CONFIG_ISOTP_FAST_RX_MAX_PACKET_COUNT=40
CONFIG_ISOTP_FAST_BLOCKING_RECEIVE=y
```

## src/main.c
```c
/*
 * Copyright (c) 2023 Brill Power
 *
 * SPDX-License-Identifier: Apache-2.0
 */

#define ISOTP_FAST_CONFORMANCE_TEST_SUITE isotp_fast_conformance_sync
#include "sync_recv.h"

#include "../../conformance/src/main.c"
```

## src/sync_recv.h
```c
/*
 * Copyright (c) 2023 Brill Power
 *
 * SPDX-License-Identifier: Apache-2.0
 */

#include "../../conformance/src/main.h"

static int blocking_recv(uint8_t *buf, size_t size, k_timeout_t timeout)
{
    struct can_filter sender = {
        .id = 0,
        .mask = 0,
    };
    return isotp_fast_recv(&ctx, sender, buf, size, timeout);
}

void isotp_fast_recv_handler(struct net_buf *buffer, int rem_len, isotp_fast_msg_id sender_addr,
                             void *arg)
{}

void isotp_fast_recv_error_handler(int8_t error, isotp_fast_msg_id sender_addr, void *arg)
{}
```
